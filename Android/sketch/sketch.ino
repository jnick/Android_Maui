// Подключаем библиотеку SoftwareSerial — она эмулирует аппаратный последовательный порт на программных пинах
#include <SoftwareSerial.h>
// Комментарий: пины для Bluetooth-модуля — (RX, TX)
// Создаём программный последовательный порт bluetooth: прием данных — пин 10 (RX), передача — пин 11 (TX)
SoftwareSerial bluetooth(10, 11);
// Константа: номер пина, к которому подключён светодиод (встроенный LED на плате — пин 13)
const int LED_PIN = 13;
// Функция setup() вызывается один раз при включении платы — здесь выполняется начальная настройка
void setup() {
  // Настраиваем пин светодиода на вывод (может выдавать напряжение HIGH/LOW)
  pinMode(LED_PIN, OUTPUT);
  // Устанавливаем на пине светодиода логический ноль — светодиод изначально выключен
  digitalWrite(LED_PIN, LOW);
  // Пустая строка — визуальный отступ перед сообщениями в мониторе порта

  // Запускаем аппаратный порт Serial (USB-соединение с компьютером) со скоростью 9600 бод
  Serial.begin(9600);
  // Пустая строка — визуальный отступ в коде

  // Комментарий: скорость обмена данными с HC-05/HC-06 в режиме данных — заводские 9600
  // Запускаем программный порт Bluetooth-модуля со скоростью 9600 бод (должна совпадать со скоростью модуля)
  bluetooth.begin(9600);
  // Пустая строка — визуальный отступ перед выводом подсказок

  // Выводим в монитор порта заголовок: программа управления светодиодом через AT-команды и Bluetooth
  Serial.println("=== AT + LED Control ===");
  // Выводим подсказку: символ «1» включает светодиод на пине 13
  Serial.println("1 - включить LED (pin 13)");
  // Выводим подсказку: символ «0» выключает светодиод на пине 13
  Serial.println("0 - выключить LED (pin 13)");
  // Выводим подсказку: символы с префиксом AT... передаются в Bluetooth-модуль
  Serial.println("AT... - отправить команду в Bluetooth");
  // Выводим подсказку: параметры монитора порта — 9600 бод, режим строковых символов «Both NL & CR»
  Serial.println("Монитор порта: 9600, 'Both NL & CR'.");
  // Закрывающая скобка функции setup()
}
// Функция loop() вызывается циклически после setup() — здесь выполняется основная работа программы
void loop() {
  // Комментарий: данные от Bluetooth (телефон): обрабатываем команду и эхом выводим в USB-монитор
  // Проверяем, пришли ли байты от Bluetooth-модуля (если да — условие истинно)
  if (bluetooth.available()) {
    // Читаем один байт из Bluetooth-порта и сохраняем его в переменную c
    char c = bluetooth.read();
    // Передаём прочитанный символ в обработчик команд — там решается, управлять ли светодиодом
    handleCommand(c);
    // Выводим полученный символ в USB-монитор порта (эхо-отображение того, что прислал телефон)
    Serial.write(c);
    // Закрывающая скобка блока приёма данных от Bluetooth
  }
  // Пустая строка — визуальный отступ между блоками

  // Комментарий: данные от USB-монитора: обрабатываем команду и передаём в Bluetooth
  // Проверяем, пришли ли байты с USB-монитора порта (если да — условие истинно)
  if (Serial.available()) {
    // Читаем один байт из USB-порта и сохраняем его в переменную c
    char c = Serial.read();
    // Передаём прочитанный символ в обработчик команд — там решается, управлять ли светодиодом
    handleCommand(c);
    // Отправляем введённый с монитора символ в Bluetooth-модуль (для передачи на телефон)
    bluetooth.write(c);
    // Закрывающая скобка блока приёма данных с USB-порта
  }
  // Закрывающая скобка функции loop()
}

// Комментарий: общая обработка команды '1' / '0' (LED на пине 13)
// Функция handleCommand принимает символ c и выполняет действие в зависимости от его значения
void handleCommand(char c) {
  // Проверяем: равна ли полученная команда символу «1» (включить светодиод)
  if (c == '1') {
    // Устанавливаем на пине светодиода высокий уровень — светодиод включается
    digitalWrite(LED_PIN, HIGH);
    // Выводим в монитор порта подтверждение, что светодиод включён
    Serial.println("LED ON");
  // Иначе проверяем: равна ли полученная команда символу «0» (выключить светодиод)
  } else if (c == '0') {
    // Устанавливаем на пине светодиода низкий уровень — светодиод выключается
    digitalWrite(LED_PIN, LOW);
    // Выводим в монитор порта подтверждение, что светодиод выключен
    Serial.println("LED OFF");
  // Закрывающая скобка ветки else if
  }
  // Закрывающая скобка функции handleCommand
}